## boards/shields/berylline/Kconfig.shield
```kconfig
config SHIELD_BERYLLINE_LEFT
	def_bool $(shields_list_contains,berylline_left)

config SHIELD_BERYLLINE_RIGHT
	def_bool $(shields_list_contains,berylline_right)
```
